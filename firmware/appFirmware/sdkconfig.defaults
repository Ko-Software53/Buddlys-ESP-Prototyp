## firmware/appFirmware/sdkconfig.defaults
```kconfig
CONFIG_IDF_TARGET="esp32s3"
CONFIG_ESP_MAIN_TASK_STACK_SIZE=16384
CONFIG_FREERTOS_HZ=1000

# Run the CPU at full 240 MHz (default was 160): more headroom for the receive
# path — TLS decrypt + cJSON parse + base64 decode of streamed audio_chunk frames
# — which at 160 MHz couldn't keep up with realtime playback (jbuf underruns).
CONFIG_ESP_DEFAULT_CPU_FREQ_MHZ_240=y

# Enable 8MB octal PSRAM (on-chip, AP_3v3)
CONFIG_SPIRAM=y
CONFIG_SPIRAM_MODE_OCT=y
CONFIG_SPIRAM_SPEED_80M=y
CONFIG_SPIRAM_USE_CAPS_ALLOC=y
CONFIG_SPIRAM_TRY_ALLOCATE_WIFI_LWIP=y

# WebSocket client
CONFIG_ESP_WEBSOCKET_CLIENT=y
CONFIG_WS_BUFFER_SIZE=65536

# ── TCP windows ──────────────────────────────────────────────────────────────
# The ESP-IDF default send/recv window is 5760 B. Over a high-RTT path to the
# cloud server (Railway, esp. via a phone hotspot) TCP throughput is capped at
# window/RTT — ~150–300 kbit/s, BELOW the 256 kbit/s of raw 16 kHz audio — so
# the streamed upload can never keep up and latency balloons. 64800 B (45×MSS,
# under the 65535 no-window-scaling limit) lifts that ceiling to multi-Mbit/s.
CONFIG_LWIP_TCP_SND_BUF_DEFAULT=64800
CONFIG_LWIP_TCP_WND_DEFAULT=64800

# TLS / HTTPS not needed (plain HTTP to local server)
CONFIG_ESP_TLS_SKIP_SERVER_CERT_VERIFY=y

# Flash size (ESP32-S3 module has 8MB)
CONFIG_ESPTOOLPY_FLASHSIZE_8MB=y
CONFIG_ESPTOOLPY_FLASHSIZE="8MB"

# Custom partition table (2MB factory app)
CONFIG_PARTITION_TABLE_CUSTOM=y
CONFIG_PARTITION_TABLE_CUSTOM_FILENAME="partitions.csv"

# Heap / memory
CONFIG_HEAP_POISONING_DISABLED=y

# Increase HTTP client buffer for STT response
CONFIG_ESP_HTTP_CLIENT_ENABLE_BASIC_AUTH=n

# ── BLE / NimBLE (WiFi provisioning) ─────────────────────────────────────────
CONFIG_BT_ENABLED=y
CONFIG_BT_NIMBLE_ENABLED=y
# Use NimBLE only; Bluedroid is not needed and saves ~200 KB flash
CONFIG_BT_BLUEDROID_ENABLED=n
# Peripheral + broadcaster is all we need for provisioning
CONFIG_BT_NIMBLE_ROLE_CENTRAL=n
CONFIG_BT_NIMBLE_ROLE_OBSERVER=n
CONFIG_BT_NIMBLE_ROLE_PERIPHERAL=y
CONFIG_BT_NIMBLE_ROLE_BROADCASTER=y
# One connection handles provisioning
CONFIG_BT_NIMBLE_MAX_CONNECTIONS=1
# Larger MTU so WiFi scan results fit in fewer notifications (app requests 256)
CONFIG_BT_NIMBLE_ATT_PREFERRED_MTU=256
# SW coexistence: BLE + WiFi share the radio gracefully
CONFIG_ESP_COEX_SW_COEXIST_ENABLE=y

# Disable AMPDU RX to prevent RX DELBA and RX path wedging on some APs
CONFIG_WIFI_AMPDU_RX_ENABLED=n

# ── esp-sr Audio Front-End (barge-in / AEC) ──────────────────────────────────
# We run the AFE as AFE_TYPE_VC to get an echo-cancelled mic stream so the child
# can interrupt Buddly mid-reply. Use the ALGORITHMIC WebRTC AEC/NS/VAD (no neural
# models, no model partition payload, far less RAM/flash than the NN variants).
# All wake words stay disabled — barge-in detects speech via libfvad on the
# cleaned stream, not a keyword.
CONFIG_AFE_INTERFACE_V1=y
CONFIG_SR_NSN_WEBRTC=y
CONFIG_SR_VADN_WEBRTC=y
# Custom partition table already declares the `model` spiffs partition esp-sr expects.
```

## firmware/stableFirmware/sdkconfig.defaults
```kconfig
CONFIG_IDF_TARGET="esp32s3"
CONFIG_ESP_MAIN_TASK_STACK_SIZE=16384
CONFIG_FREERTOS_HZ=1000

# Enable 8MB octal PSRAM (on-chip, AP_3v3)
CONFIG_SPIRAM=y
CONFIG_SPIRAM_MODE_OCT=y
CONFIG_SPIRAM_SPEED_80M=y
CONFIG_SPIRAM_USE_CAPS_ALLOC=y
CONFIG_SPIRAM_TRY_ALLOCATE_WIFI_LWIP=y

# WebSocket client
CONFIG_ESP_WEBSOCKET_CLIENT=y
CONFIG_WS_BUFFER_SIZE=65536

# TLS / HTTPS not needed (plain HTTP to local server)
CONFIG_ESP_TLS_SKIP_SERVER_CERT_VERIFY=y

# Flash size (ESP32-S3 module has 8MB)
CONFIG_ESPTOOLPY_FLASHSIZE_8MB=y
CONFIG_ESPTOOLPY_FLASHSIZE="8MB"

# Custom partition table (2MB factory app)
CONFIG_PARTITION_TABLE_CUSTOM=y
CONFIG_PARTITION_TABLE_CUSTOM_FILENAME="partitions.csv"

# Heap / memory
CONFIG_HEAP_POISONING_DISABLED=y

# Increase HTTP client buffer for STT response
CONFIG_ESP_HTTP_CLIENT_ENABLE_BASIC_AUTH=n

# ── BLE / NimBLE (WiFi provisioning) ─────────────────────────────────────────
CONFIG_BT_ENABLED=y
CONFIG_BT_NIMBLE_ENABLED=y
# Use NimBLE only; Bluedroid is not needed and saves ~200 KB flash
CONFIG_BT_BLUEDROID_ENABLED=n
# Peripheral + broadcaster is all we need for provisioning
CONFIG_BT_NIMBLE_ROLE_CENTRAL=n
CONFIG_BT_NIMBLE_ROLE_OBSERVER=n
CONFIG_BT_NIMBLE_ROLE_PERIPHERAL=y
CONFIG_BT_NIMBLE_ROLE_BROADCASTER=y
# One connection handles provisioning
CONFIG_BT_NIMBLE_MAX_CONNECTIONS=1
# Larger MTU so WiFi scan results fit in fewer notifications (app requests 256)
CONFIG_BT_NIMBLE_ATT_PREFERRED_MTU=256
# SW coexistence: BLE + WiFi share the radio gracefully
CONFIG_ESP_COEX_SW_COEXIST_ENABLE=y
```
